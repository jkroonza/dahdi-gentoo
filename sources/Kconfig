## sources/Kconfig
```kconfig
config DAHDI_AP4XX
	tristate "Aligera AP4XX PCI Card Driver"
	depends on DAHDI && PCI
	default DAHDI
	---help---
	  This driver provides support for the Aligera AP400 quad-span
	  E1/T1 DAHDI cards:

	  To compile this driver as a module, choose M here: the
	  module will be called ap4xx.

	  If unsure, say Y.

config DAHDI_OPVXA1200
	tristate "OpenVox 8/12 ports analog card Support"
	depends on DAHDI && PCI
	default DAHDI
	---help---
	  This driver provides support for the following OpenVox
	  Wildcard products:

	  * A1200P (PCI)
	  * A1200E (PCI-E)
	  * A800P (PCI)
	  * A800E (PCI-E)

	  To compile this driver as a module, choose M here: the
	  module will be called opvxa1200.

	  If unsure, say Y.

config DAHDI_OPVXD115
	tristate "OpenVox Single-T1/E1/J1 Support"
	depends on DAHDI && PCI
	default DAHDI
	---help---
	  This driver provides support for the following OpenVox
	  Wildcard products:

	  * D115P/DE115P/D130P/DE130P (PCI)
	  * D115E/DE115E/D130E/DE130E (PCI-E)

	  To compile this driver as a module, choose M here: the
	  module will be called opvxd115.

	  If unsure, say Y.


config DAHDI_WCOPENPCI
	tristate "Voicetronix OpenPCI Interface DAHDI driver"
	depends on DAHDI && PCI
	default DAHDI
	---help---
	  This driver provides support for the Voicetronix OpenPCI Interface.

	  To compile this driver as a module, choose M here: the
	  module will be called wcopenpci.

	  If unsure, say Y.

config DAHDI_ZAPHFC
	tristate "HFC-S DAHDI Driver"
	depends on DAHDI && PCI
	default DAHDI
	---help---
	  This driver provides DAHDI support for various HFC-S single-port
		  ISDN (BRI) cards.

	  To compile this driver as a module, choose M here: the
	  module will be called zaphfc.

	  If unsure, say Y.
```
